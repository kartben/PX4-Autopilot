## platforms/zephyr/module/Kconfig
```kconfig
menuconfig PX4
	bool "PX4 Autopilot"
	select CPP
	select REQUIRES_FULL_LIBCPP
	select POSIX_API
	select POSIX_THREADS
	select POSIX_SEMAPHORES
	select POSIX_TIMERS
	select POSIX_PRIORITY_SCHEDULING
	select THREAD_STACK_INFO
	select THREAD_MONITOR
	select DYNAMIC_THREAD
	select DYNAMIC_THREAD_ALLOC
	select THREAD_NAME
	select REBOOT
	select FPU if CPU_HAS_FPU
	select FPU_SHARING if CPU_HAS_FPU
	help
	  Build PX4 Autopilot into this application. The PX4 modules are
	  selected by the PX4 board configuration, see PX4_BOARD_CONFIG.

if PX4

config PX4_BOARD_CONFIG
	string "PX4 board configuration"
	help
	  PX4 configuration to build, for example "zephyr_generic". When empty,
	  boards/zephyr/<board>/default.px4board is used if it exists, and
	  boards/zephyr/generic/default.px4board otherwise.

config PX4_SHELL
	bool "px4 shell command"
	default y
	depends on SHELL
	help
	  Run PX4 commands from the Zephyr shell, e.g. "uorb status" or
	  "px4 uorb status".

config PX4_MAVLINK_SHELL
	bool "MAVLink shell"
	default y
	depends on PX4_SHELL
	select THREAD_CUSTOM_DATA
	help
	  The shell of the ground stations over MAVLink (SERIAL_CONTROL), as nsh
	  on NuttX: a Zephyr shell instance that runs the PX4 commands, with
	  their standard output, and the commands of the Zephyr shell. Built
	  when the PX4 board configuration has MAVLink.

if PX4_MAVLINK_SHELL

config PX4_MAVLINK_SHELL_PROMPT
	string "MAVLink shell prompt"
	default "px4> "

config PX4_MAVLINK_SHELL_INPUT_BUFFER_SIZE
	int "Characters received from MAVLink buffered"
	default 256
	help
	  Characters that the ground station sends while the shell runs a
	  command, which the shell reads once the command exits.

config PX4_MAVLINK_SHELL_OUTPUT_BUFFER_SIZE
	int "Characters of output buffered for MAVLink"
	default 1024
	help
	  Output of the shell and of its commands, which MAVLink sends in
	  SERIAL_CONTROL messages of 70 characters.

endif # PX4_MAVLINK_SHELL

config PX4_SENSORS
	bool "Sensors for PX4"
	default y
	depends on DT_HAS_PX4_SENSORS_ENABLED
	select SENSOR
	select SENSOR_ASYNC_API
	select RTIO_CQE_CALLBACK
	help
	  Enable the Zephyr sensor API for the sensors in the px4,sensors
	  devicetree node, which the PX4 zephyr_sensors driver publishes.

config PX4_SENSORS_FIFO_BUFFER_SIZE
	int "FIFO data buffered for each IMU"
	default 2048
	depends on PX4_SENSORS
	help
	  Bytes buffered for the FIFO reads of each IMU that has its interrupt
	  pin in the devicetree, which the zephyr_sensors driver streams if
	  its Zephyr driver supports it. They hold at least two FIFO reads of
	  the watermark, while the previous ones are published.

config PX4_SERIAL
	bool "Serial ports for PX4"
	default y
	depends on DT_HAS_PX4_SERIAL_PORTS_ENABLED
	depends on SERIAL && SERIAL_SUPPORT_INTERRUPT
	select UART_INTERRUPT_DRIVEN
	select POLL
	select XSI_STREAMS
	select UART_LINE_CTRL if USBD_CDC_ACM_CLASS
	help
	  Open the UARTs of the px4,serial-ports devicetree node as device
	  files, for example /dev/ttyS2, which PX4 configures with termios.

config ZVFS_OPEN_ADD_SIZE_PX4_SERIAL
	int "Serial ports open at the same time"
	default 8
	depends on PX4_SERIAL
	help
	  File descriptors added for the serial ports.

config PX4_STORAGE
	bool "Storage for PX4"
	default y
	depends on DT_HAS_ZEPHYR_FSTAB_FATFS_ENABLED
	select FILE_SYSTEM
	select FAT_FILESYSTEM_ELM
	select FS_FATFS_LFN
	select POSIX_FILE_SYSTEM
	imply FILE_SYSTEM_MKFS if DT_HAS_ZEPHYR_RAM_DISK_ENABLED
	help
	  Keep the parameters, missions and logs of PX4 on the FAT file system
	  of the devicetree fstab, mounted at the root path of the PX4 board
	  configuration, for example /SD:. A RAM disk is formatted when it is
	  first mounted, an SD card never.

config ZVFS_OPEN_ADD_SIZE_PX4_STORAGE
	int "Files open at the same time"
	default 8
	depends on PX4_STORAGE
	help
	  File descriptors added for the files of PX4.

config PX4_COMPONENT_METADATA
	bool "Component metadata"
	default y
	select POSIX_FILE_SYSTEM
	help
	  Build the component metadata of PX4 (parameters, events and
	  actuators) into the firmware when the PX4 board configuration has
	  MAVLink, for ground stations to download with MAVLink FTP. The files
	  are in /etc/extras, as on NuttX, on a read-only file system mounted
	  at /etc.

config ZVFS_OPEN_ADD_SIZE_PX4_COMPONENT_METADATA
	int "Metadata files open at the same time"
	default 4
	depends on PX4_COMPONENT_METADATA
	help
	  File descriptors added for the files and directories of /etc.

config PX4_CAN
	bool "CAN buses for PX4"
	default y
	depends on DT_HAS_PX4_CAN_BUSES_ENABLED
	select CAN
	help
	  Give PX4 the CAN controllers of the px4,can-buses devicetree node, as
	  CAN1, CAN2 and so on, for DroneCAN.

config PX4_CAN_RX_QUEUE_SIZE
	int "Received frames queued per CAN bus"
	default 32
	depends on PX4_CAN

config PX4_CAN_TX_SLOTS
	int "Frames sent at the same time per CAN bus"
	default 8
	range 1 255
	depends on PX4_CAN

config PX4_PWM_OUTPUTS
	bool "PWM outputs for PX4"
	default y
	depends on DT_HAS_PX4_PWM_OUTPUTS_ENABLED
	select PWM
	help
	  Enable the Zephyr PWM API for the outputs of the px4,pwm-outputs
	  devicetree node, which the PX4 zephyr_pwm_out driver drives as the
	  main outputs.

config PX4_RC_INPUT
	bool "RC input for PX4"
	default y
	depends on DT_HAS_PX4_RC_INPUT_ENABLED
	select INPUT
	imply UART_INTERRUPT_DRIVEN if DT_HAS_FUTABA_SBUS_ENABLED
	imply UART_ASYNC_API if DT_HAS_TBS_CRSF_ENABLED
	help
	  Enable the input subsystem for the input device of the px4,rc-input
	  devicetree node, such as an SBUS or a CRSF receiver, whose events the
	  PX4 zephyr_rc_input driver publishes as RC input, and the UART API that
	  the SBUS (interrupt-driven) or CRSF (asynchronous) driver needs.

config PX4_BUZZER
	bool "Buzzer for PX4"
	default y
	depends on $(dt_alias_enabled,buzzer0)
	select BUZZER
	help
	  Enable the buzzer driver of the buzzer0 devicetree alias, on which the
	  PX4 tone_alarm driver plays its tunes. Disable it if the PX4 board
	  configuration has no tone_alarm.

config PX4_LEDS
	bool "LEDs for PX4"
	default y
	depends on DT_HAS_PX4_LEDS_ENABLED
	select LED
	help
	  Enable the LED drivers of the LEDs of the px4,leds devicetree node:
	  the board LEDs of PX4, which Commander drives through /dev/led0, and
	  the RGB LEDs on which the PX4 zephyr_rgbled driver shows the system
	  status.

config PX4_SAFETY_BUTTON
	bool "Safety button for PX4"
	default y
	depends on DT_HAS_PX4_SAFETY_BUTTON_ENABLED
	select GPIO
	help
	  Read the button of the px4,safety-button devicetree node with the
	  Zephyr GPIO API, for the PX4 safety_button driver, which also blinks
	  the safety LED of the px4,leds node.

config PX4_DSHOT_PULSE_IO
	bool "DShot on pulse_io channels"
	default y
	depends on DT_HAS_PX4_DSHOT_PULSE_IO_ENABLED
	select PULSE_IO
	select RTIO
	help
	  Enable the DShot devices of the px4,dshot-pulse-io devicetree nodes,
	  which send the frames of the PX4 dshot driver on pulse_io channels,
	  such as the channels of an STM32 timer, and receive the replies of
	  bidirectional DShot on half duplex channels through RTIO.

config PX4_DSHOT_PULSE_IO_INIT_PRIORITY
	int "Init priority of the DShot devices on pulse_io channels"
	default 85
	depends on PX4_DSHOT_PULSE_IO
	help
	  Device init priority of the px4,dshot-pulse-io devices, after their
	  pulse_io controllers (PULSE_IO_INIT_PRIORITY).

DT_COMPAT_PX4_LEDS := px4,leds

config PX4_SAFETY_LED
	def_bool $(dt_compat_any_has_prop,$(DT_COMPAT_PX4_LEDS),safety)
	depends on PX4_SAFETY_BUTTON && PX4_LEDS
	help
	  The px4,leds devicetree node has a safety LED, which the PX4
	  safety_button driver blinks.

config PX4_ADC
	bool "Board ADC for PX4"
	default y
	depends on DT_HAS_PX4_ADC_ENABLED
	select ADC
	help
	  Enable the Zephyr ADC API for the channels of the px4,adc devicetree
	  node, which the PX4 board_adc driver samples. Disable it if the PX4
	  board configuration has no board_adc.

config PX4_STACK_OVERHEAD
	int "Stack overhead"
	default 1024
	help
	  Bytes added to the stack size of every PX4 task and work queue, for
	  the kernel, the C library and the floating point context.

DT_CHOSEN_PX4_ITCM := zephyr,itcm

config PX4_ITCM
	bool "Run the most used code from ITCM"
	depends on XIP
	depends on $(dt_chosen_enabled,$(DT_CHOSEN_PX4_ITCM))
	select CODE_DATA_RELOCATION
	help
	  Copy the code that runs at the rate of the IMU to the ITCM at boot,
	  and run it from there instead of in place from the flash. For boards
	  whose flash is slow to fetch instructions from.

config PX4_FLEXSPI_PREFETCH_OFF
	bool "No AHB read prefetch of the FlexSPI flash"
	default y
	depends on SOC_SERIES_IMXRT11XX && FLASH_MCUX_FLEXSPI_XIP
	help
	  Turn off the AHB read prefetch that the boot ROM leaves on for the
	  flash the firmware runs from, which Zephyr keeps when running in
	  place. A fetch from the flash then waits for the prefetch of other
	  data to finish: on the MIMXRT1170-EVK, the CPU stalls for 50 to
	  60 us many times per second, also with interrupts locked, which
	  delays the interrupts by as much.

endif # PX4

choice STD_CPP
	default STD_CPP17 if PX4
endchoice

choice PICOLIBC_IO_LEVEL
	default PICOLIBC_IO_FLOAT if PX4
endchoice

# the RC input events are handled in the thread of the input driver, instead of the input thread,
# which has the lowest priority
choice INPUT_MODE
	default INPUT_MODE_SYNCHRONOUS if PX4_RC_INPUT
endchoice

if PX4

# the PX4 priorities, mapped in order: the top 64 one to one, the others below them
configdefault NUM_PREEMPT_PRIORITIES
	default 127

# the hrt callouts run on the kernel tick: 1 us, as the hrt of NuttX, instead of 10 us, where the system timer
# counts at least that fast
configdefault SYS_CLOCK_TICKS_PER_SEC
	default 1000000 if TICKLESS_KERNEL && SYS_CLOCK_HW_CYCLES_PER_SEC >= 1000000
	default 100000 if TICKLESS_KERNEL && SYS_CLOCK_HW_CYCLES_PER_SEC >= 100000

# hrt_absolute_time() counts the cycles of the system timer, which wrap after minutes in 32 bits
configdefault CORTEX_M_SYSTICK_64BIT_CYCLE_COUNTER
	default y

configdefault POSIX_THREAD_THREADS_MAX
	default 32

configdefault MAX_PTHREAD_MUTEX_COUNT
	default 64

configdefault FS_FATFS_NUM_FILES
	default 8 if PX4_STORAGE

# without FAT long file names, directory entries have names of 12 characters at most, shorter than
# the names of the metadata files
configdefault FILE_SYSTEM_MAX_FILE_NAME
	default 255 if PX4_COMPONENT_METADATA && !FAT_FILESYSTEM_ELM

configdefault MAX_PTHREAD_COND_COUNT
	default 64

configdefault HEAP_MEM_POOL_SIZE
	default 131072

# the startup script runs on the main thread, which then exits: it uses 1.5 KiB of the stack in
# the SIH configuration
configdefault MAIN_STACK_SIZE
	default 4096

# debugging commands and features of the Zephyr shell that PX4 doesn't use
configdefault DEVMEM_SHELL
	default n

configdefault DATE_SHELL
	default n

configdefault DEVICE_SHELL
	default n

configdefault SHELL_WILDCARD
	default n

configdefault SHELL_STATS
	default n

# PX4 commands run on the shell thread
configdefault SHELL_STACK_SIZE
	default 4096 if PX4_SHELL

# the board identity is the device ID of the hwinfo driver
configdefault HWINFO
	default y

# the sensors of each bus are read at the same time, and most sensor drivers read on the RTIO work
# queue
configdefault RTIO_WORKQ_THREADS_POOL
	default 8 if PX4_SENSORS

configdefault RTIO_WORKQ_POOL_ITEMS
	default 8 if PX4_SENSORS

# CPU load and stack usage of the threads, for top, load_mon and the logger
configdefault THREAD_RUNTIME_STATS
	default y

configdefault INIT_STACKS
	default y

# RAM usage of load_mon
configdefault SYS_HEAP_RUNTIME_STATS
	default y

# the CRSF thread, which also runs the RC input callback, at the priority of the wq:ttyS1 work queue
# of the serial RC drivers, instead of the top priority
configdefault INPUT_CRSF_THREAD_PRIORITY
	default 22 if PX4_RC_INPUT

endif # PX4
```

## platforms/zephyr/tests/dshot/testcase.yaml
```yaml
common:
  tags:
    - px4
  platform_allow:
    - mps2/an386
    - vmu_rt1170/mimxrt1176/cm7
  integration_platforms:
    - mps2/an386
tests:
  px4.dshot: {}
```

## platforms/zephyr/tests/identity/testcase.yaml
```yaml
common:
  tags:
    - px4
tests:
  px4.identity.override:
    platform_allow:
      - mps2/an386
    integration_platforms:
      - mps2/an386
  px4.identity.hwinfo_fake:
    platform_allow:
      - mps2/an386
    integration_platforms:
      - mps2/an386
    extra_configs:
      - CONFIG_PX4_TEST_HWINFO=y
  px4.identity.hwinfo:
    platform_allow:
      - mimxrt1170_evk@A/mimxrt1176/cm7
      - mimxrt1170_evk@B/mimxrt1176/cm7
```

## platforms/zephyr/tests/safety_button/testcase.yaml
```yaml
common:
  tags:
    - px4
  platform_allow:
    - mps2/an386
    - mimxrt1170_evk@A/mimxrt1176/cm7
    - mimxrt1170_evk@B/mimxrt1176/cm7
  integration_platforms:
    - mps2/an386
tests:
  px4.safety_button: {}
  # a board without a safety LED, nor the gpio-keys input driver
  px4.safety_button.no_led:
    extra_dtc_overlay_files:
      - app.overlay
      - no_led.overlay
    extra_configs:
      - CONFIG_INPUT=n
```
