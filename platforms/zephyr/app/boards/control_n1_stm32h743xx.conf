## platforms/zephyr/app/sample.yaml
```yaml
sample:
  name: PX4 Autopilot
  description: PX4 running on Zephyr
common:
  tags:
    - px4
tests:
  px4.app:
    platform_allow:
      - mps2/an386
    integration_platforms:
      - mps2/an386
    harness: console
    harness_config:
      type: multi_line
      ordered: true
      regex:
        - "HW arch: ZEPHYR_GENERIC"
        - "OS: Zephyr"
  px4.app.sih:
    platform_allow:
      - mps2/an386
    integration_platforms:
      - mps2/an386
    extra_args:
      - FILE_SUFFIX=sih
    timeout: 600
    harness: pytest
    harness_config:
      pytest_root:
        - "pytest/test_sih.py"
      pytest_dut_scope: session
  px4.app.sih.mavlink_serial:
    platform_allow:
      - mps2/an386
    integration_platforms:
      - mps2/an386
    extra_args:
      - FILE_SUFFIX=sih
      - EXTRA_CONF_FILE=boards/mps2_an386_serial.conf
      - EXTRA_DTC_OVERLAY_FILE=boards/mps2_an386_serial.overlay
    timeout: 600
    harness: pytest
    harness_config:
      pytest_root:
        - "pytest/test_mavlink_serial.py"
      pytest_dut_scope: session
  px4.app.vmu_rt1170:
    build_only: true
    platform_allow:
      - vmu_rt1170/mimxrt1176/cm7
    integration_platforms:
      - vmu_rt1170/mimxrt1176/cm7
  px4.app.sih.vmu_rt1170:
    build_only: true
    platform_allow:
      - vmu_rt1170/mimxrt1176/cm7
    integration_platforms:
      - vmu_rt1170/mimxrt1176/cm7
    extra_args:
      - FILE_SUFFIX=sih
```

## platforms/zephyr/dts/bindings/px4,adc.yaml
```yaml
description: |
  Channels of the PX4 board ADC, which the board_adc driver samples and
  publishes to adc_report, from which the battery_status module measures the
  analog batteries.

  PX4 numbers the channels from 0, in the order of io-channels. The name of a
  channel gives the PX4 channel macro that board_config.h defines with NuttX:
  a channel named "scaled-v5" is ADC_SCALED_V5_CHANNEL. The power rails are
  published to system_power:

    - scaled-v5: the 5 V rail, through a voltage divider of 2, or of
      ADC_V5_V_FULL_SCALE / 3.3 if board_config.h defines it.
    - scaled-vdd-3v3-sensors, or scaled-vdd-3v3-sensors1 to
      scaled-vdd-3v3-sensors4: the 3.3 V rails of the sensors, through a
      voltage divider of 2, or of ADC_3V3_SCALE.

  The analog batteries are published to battery_status:

    - battery-voltage and battery-current: the voltage and current of a
      battery, scaled with the BAT1_V_DIV and BAT1_A_PER_V parameters.
    - battery1-voltage, battery1-current, battery2-voltage and
      battery2-current: the voltages and currents of two batteries, scaled
      with BAT1_* and BAT2_*.

  BATn_V_CHANNEL selects another channel, by its number, for the voltage of
  battery n.

  The other channels, such as the inputs of an ADC connector, are only
  published to adc_report. Each channel is configured by its channel node on
  its ADC, and all channels have the same resolution and full scale, from the
  reference voltage and the gain:

    / {
      px4-adc {
        compatible = "px4,adc";
        io-channels = <&adc1 0>, <&adc1 1>, <&adc1 2>;
        io-channel-names = "scaled-v5", "scaled-vdd-3v3-sensors", "adc-3v3";
      };
    };

compatible: "px4,adc"

properties:
  io-channels:
    type: phandle-array
    required: true
    description: ADC channels, up to 16, the size of adc_report.
  io-channel-names:
    type: string-array
    required: true
    description: Name of each channel, which gives its PX4 channel macro.
```

## platforms/zephyr/dts/bindings/px4,can-buses.yaml
```yaml
description: |
  CAN buses of PX4, numbered in the order of the child nodes: the first one
  is CAN1, the second CAN2 and so on, as the PX4 parameters and drivers
  number them.

    / {
      px4-can-buses {
        compatible = "px4,can-buses";

        can1 {
          can = <&flexcan1>;
        };

        can2 {
          can = <&flexcan2>;
        };
      };
    };

compatible: "px4,can-buses"

child-binding:
  description: A CAN bus.
  properties:
    can:
      type: phandle
      required: true
      description: CAN controller.
```

## platforms/zephyr/dts/bindings/px4,dshot-pulse-io.yaml
```yaml
description: |
  DShot device on pulse_io channels, with the driver API of px4_dshot.h:
  DShot channel n is the pulse_io channel of entry n of pulse-ios, for
  example the channels of an STM32 timer (st,stm32-pulse-io):

    dshot0: dshot {
      compatible = "px4,dshot-pulse-io";
      #dshot-cells = <1>;
      pulse-ios = <&tim1_pio 0>, <&tim1_pio 1>, <&tim1_pio 2>, <&tim1_pio 3>;
    };

  The frames are sent as fixed-period cells, or as symbols if the
  controller has no cells with a duty cycle. The pulse_io API has no
  transmit that starts several channels at once: the frames of the channels
  are sent one after the other. Bidirectional DShot isn't supported.

compatible: "px4,dshot-pulse-io"

include: px4-dshot-controller.yaml

properties:
  pulse-ios:
    type: phandle-array
    required: true
    description: |
      pulse_io channel of each DShot channel, in the order of the DShot
      channels, at most 32.
```

## platforms/zephyr/dts/bindings/px4,leds.yaml
```yaml
description: |
  LEDs of PX4.

  The board LEDs are the LEDs that PX4 turns on and off with led_on(),
  led_off() and led_toggle(), and through /dev/led0, for example to show
  the armed state and the CPU overload with Commander. Each one is named
  after its PX4 LED: blue for LED_BLUE, red for LED_RED and LED_AMBER, and
  green for LED_GREEN.

  Each LED is a child node of an LED controller, such as gpio-leds or
  pwm-leds, or a leds-group-multicolor:

    / {
      px4-leds {
        compatible = "px4,leds";
        blue = <&blue_led>;
        red = <&red_led>;
        green = <&green_led>;
      };
    };

compatible: "px4,leds"

properties:
  blue:
    type: phandle
    description: LED_BLUE.
  red:
    type: phandle
    description: LED_RED, also LED_AMBER.
  green:
    type: phandle
    description: LED_GREEN.
```

## platforms/zephyr/dts/bindings/px4,pwm-outputs.yaml
```yaml
description: |
  PWM outputs of PX4, the main outputs in the order of the child nodes: the
  first one is configured with PWM_MAIN_FUNC1, PWM_MAIN_DIS1 and so on, as
  the PX4 zephyr_pwm_out driver drives them.

  Many PWM controllers have one period for all their channels, such as an
  STM32 timer or the channels A and B of an NXP FlexPWM submodule: outputs
  on the same PWM device then need the same period.

  An output with a dshot property can be driven with DShot instead, by the
  PX4 dshot driver, when its PWM_MAIN_TIM<n> parameter selects DShot.

    #include <zephyr/dt-bindings/pwm/pwm.h>

    / {
      px4-pwm-outputs {
        compatible = "px4,pwm-outputs";

        main1 {
          pwms = <&flexpwm1_pwm0 0 PWM_HZ(400) PWM_POLARITY_NORMAL>;
          dshot = <&dshot0 0>;
        };

        main2 {
          pwms = <&flexpwm1_pwm1 0 PWM_HZ(50) PWM_POLARITY_NORMAL>;
        };
      };
    };

compatible: "px4,pwm-outputs"

child-binding:
  description: A PWM output.
  properties:
    pwms:
      type: phandle-array
      required: true
      description: |
        PWM channel, with the period of the output, for example PWM_HZ(400)
        for ESCs or PWM_HZ(50) for analog servos. The period is at least
        2200 us, the longest pulse of the PWM_MAIN parameters.
    dshot:
      type: phandle-array
      specifier-space: dshot
      description: |
        DShot device and channel of the output, see px4-dshot-controller.yaml.
        The PX4 dshot driver sends DShot frames on it when PWM_MAIN_TIM<n> of
        the output, from PWM_MAIN_TIM0 for the first one, selects DShot or
        bidirectional DShot. zephyr_pwm_out then leaves the PWM channel of
        the output alone.
```

## platforms/zephyr/dts/bindings/px4,rc-input.yaml
```yaml
description: |
  RC input of PX4 from a Zephyr input device, such as an SBUS receiver
  (futaba,sbus), which the PX4 zephyr_rc_input driver publishes as input_rc.

  The channels property gives the input event of each RC channel, as its
  type and code, in the order of the RC channels:

    #include <zephyr/dt-bindings/input/input-event-codes.h>

    / {
      px4-rc-input {
        compatible = "px4,rc-input";
        input = <&sbus>;
        channels = <INPUT_EV_ABS INPUT_ABS_RX>,
                   <INPUT_EV_ABS INPUT_ABS_RY>,
                   <INPUT_EV_ABS INPUT_ABS_Y>,
                   <INPUT_EV_ABS INPUT_ABS_X>,
                   <INPUT_EV_MSC 5>;
      };
    };

  The value of an INPUT_EV_ABS or INPUT_EV_MSC event is scaled from
  input-min..input-max to 1000..2000 us, as PX4 scales the SBUS channels.
  A key gives 2000 us while it is pressed and 1000 us while it is released,
  which it is until its first event.

  The input device sends a sync event after each frame. The channels are
  published from the first frame after which each of them has been
  reported.

compatible: "px4,rc-input"

properties:
  input:
    type: phandle
    required: true
    description: Input device.
  channels:
    type: array
    required: true
    description: |
      Type (INPUT_EV_ABS, INPUT_EV_MSC or INPUT_EV_KEY) and code of the input
      event of each RC channel, from the first one, up to 18 channels.
  input-min:
    type: int
    default: 200
    description: |
      Raw value of a channel at 1000 us. Default: the SBUS value at -100%.
  input-max:
    type: int
    default: 1800
    description: |
      Raw value of a channel at 2000 us. Default: the SBUS value at +100%.
  failsafe:
    type: array
    description: |
      Type and code of an input event whose value is not 0 while the
      receiver is in failsafe, for example because it has lost the
      transmitter.
```

## platforms/zephyr/dts/bindings/px4,safety-button.yaml
```yaml
description: |
  Safety button of PX4, such as the safety switch of a GPS module, which the
  PX4 safety_button driver reads.

  The button is a node with a gpios property, such as a child of gpio-keys,
  pressed while its GPIO is active. The driver reads it every 33 ms and
  debounces it: it publishes a safety button event once the button has been
  pressed for 1 second, and a ground station pairing request after 3 presses
  within 2 seconds. It blinks the safety and armed states on the safety LED
  of the px4,leds node, if it has one.

    / {
      gpio-keys {
        compatible = "gpio-keys";

        safety_switch: safety-switch {
          gpios = <&gpio1 24 (GPIO_PULL_DOWN | GPIO_ACTIVE_HIGH)>;
          zephyr,code = <INPUT_KEY_0>;
        };
      };

      px4-safety-button {
        compatible = "px4,safety-button";
        button = <&safety_switch>;
      };
    };

compatible: "px4,safety-button"

properties:
  button:
    type: phandle
    required: true
    description: |
      The button, a node with a gpios property, such as a child of gpio-keys.
```

## platforms/zephyr/dts/bindings/px4,sensors.yaml
```yaml
description: |
  Zephyr sensors published to uORB by the PX4 zephyr_sensors driver.

  Each child node selects a sensor device and how PX4 uses it:

    #include <dt-bindings/px4/rotation.h>

    / {
      px4-sensors {
        compatible = "px4,sensors";

        imu0 {
          sensor = <&icm42688>;
          type = "imu";
          rotation = <PX4_ROTATION_ROLL_180>;
        };

        mag0 {
          sensor = <&ist8310>;
          type = "mag";
          external;
        };
      };
    };

compatible: "px4,sensors"

child-binding:
  description: A sensor published to uORB.
  properties:
    sensor:
      type: phandle
      required: true
      description: Sensor device, which implements the Zephyr sensor API.
    type:
      type: string
      required: true
      enum:
        - "imu"
        - "accel"
        - "gyro"
        - "mag"
        - "baro"
      description: |
        Measurements published: imu publishes sensor_accel and sensor_gyro,
        accel sensor_accel, gyro sensor_gyro, mag sensor_mag and baro
        sensor_baro.
    rotation:
      type: int
      default: 0
      description: |
        Rotation from the sensor frame to the board frame, one of the
        PX4_ROTATION_* values in dt-bindings/px4/rotation.h.
    external:
      type: boolean
      description: The sensor is not on the flight controller board.
```

## platforms/zephyr/dts/bindings/px4,serial-ports.yaml
```yaml
description: |
  Serial ports that PX4 opens as device files, for MAVLink, GPS receivers
  and the other PX4 drivers of serial devices.

  Each child node gives the path of a UART, as the PX4 board configuration
  and the startup script refer to it:

    / {
      px4-serial-ports {
        compatible = "px4,serial-ports";

        telem1 {
          uart = <&lpuart4>;
          path = "/dev/ttyS2";
        };

        usb {
          uart = <&cdc_acm_uart0>;
          path = "/dev/ttyACM0";
        };
      };
    };

compatible: "px4,serial-ports"

child-binding:
  description: A serial port.
  properties:
    uart:
      type: phandle
      required: true
      description: UART device, which implements the interrupt-driven UART API.
    path:
      type: string
      required: true
      description: Path of the device file, for example "/dev/ttyS2".
    rx-buffer-size:
      type: int
      default: 512
      description: Size of the receive buffer, in bytes.
    tx-buffer-size:
      type: int
      default: 1024
      description: Size of the transmit buffer, in bytes.
```

## platforms/zephyr/dts/bindings/px4-dshot-controller.yaml
```yaml
description: |
  DShot device, with the driver API of px4_dshot.h, on whose channels the PX4
  dshot driver sends the DShot frames of the outputs of the px4,pwm-outputs
  node that refer to them with their dshot property, for example:

    dshot = <&dshot0 2>;

properties:
  "#dshot-cells":
    type: int
    required: true
    const: 1
    description: Number of cells of a dshot specifier, the channel.

dshot-cells:
  - channel
```
