## platforms/zephyr/tests/sensors/testcase.yaml
```yaml
common:
  tags:
    - px4
  platform_allow:
    - mps2/an386
    - mimxrt1170_evk@A/mimxrt1176/cm7
    - mimxrt1170_evk@B/mimxrt1176/cm7
  integration_platforms:
    - mps2/an386
tests:
  px4.sensors: {}
```

## src/drivers/lights/zephyr_rgbled/Kconfig
```kconfig
menuconfig DRIVERS_LIGHTS_ZEPHYR_RGBLED
	bool "zephyr_rgbled"
	default n
	depends on PLATFORM_ZEPHYR
	---help---
		Show the system status on the RGB LEDs of the px4,leds devicetree node
```

## src/drivers/zephyr_pwm_out/Kconfig
```kconfig
menuconfig DRIVERS_ZEPHYR_PWM_OUT
	bool "zephyr_pwm_out"
	default n
	depends on PLATFORM_ZEPHYR
	---help---
		Drive the PWM outputs listed in the px4,pwm-outputs devicetree node
```

## src/drivers/zephyr_rc_input/Kconfig
```kconfig
menuconfig DRIVERS_ZEPHYR_RC_INPUT
	bool "zephyr_rc_input"
	default n
	depends on PLATFORM_ZEPHYR
	---help---
		Publish the RC input of the Zephyr input device of the px4,rc-input devicetree node
```

## src/drivers/zephyr_sensors/Kconfig
```kconfig
menuconfig DRIVERS_ZEPHYR_SENSORS
	bool "zephyr_sensors"
	default n
	depends on PLATFORM_ZEPHYR
	---help---
		Publish the Zephyr sensors listed in the px4,sensors devicetree node
```
