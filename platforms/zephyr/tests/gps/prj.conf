## CMakeLists.txt
```
############################################################################
#
#   Copyright (c) 2026 PX4 Development Team. All rights reserved.
#
# Redistribution and use in source and binary forms, with or without
# modification, are permitted provided that the following conditions
# are met:
#
# 1. Redistributions of source code must retain the above copyright
#    notice, this list of conditions and the following disclaimer.
# 2. Redistributions in binary form must reproduce the above copyright
#    notice, this list of conditions and the following disclaimer in
#    the documentation and/or other materials provided with the
#    distribution.
# 3. Neither the name PX4 nor the names of its contributors may be
#    used to endorse or promote products derived from this software
#    without specific prior written permission.
#
# THIS SOFTWARE IS PROVIDED BY THE COPYRIGHT HOLDERS AND CONTRIBUTORS
# "AS IS" AND ANY EXPRESS OR IMPLIED WARRANTIES, INCLUDING, BUT NOT
# LIMITED TO, THE IMPLIED WARRANTIES OF MERCHANTABILITY AND FITNESS
# FOR A PARTICULAR PURPOSE ARE DISCLAIMED. IN NO EVENT SHALL THE
# COPYRIGHT OWNER OR CONTRIBUTORS BE LIABLE FOR ANY DIRECT, INDIRECT,
# INCIDENTAL, SPECIAL, EXEMPLARY, OR CONSEQUENTIAL DAMAGES (INCLUDING,
# BUT NOT LIMITED TO, PROCUREMENT OF SUBSTITUTE GOODS OR SERVICES; LOSS
# OF USE, DATA, OR PROFITS; OR BUSINESS INTERRUPTION) HOWEVER CAUSED
# AND ON ANY THEORY OF LIABILITY, WHETHER IN CONTRACT, STRICT
# LIABILITY, OR TORT (INCLUDING NEGLIGENCE OR OTHERWISE) ARISING IN
# ANY WAY OUT OF THE USE OF THIS SOFTWARE, EVEN IF ADVISED OF THE
# POSSIBILITY OF SUCH DAMAGE.
#
############################################################################

cmake_minimum_required(VERSION 3.20.0)

find_package(Zephyr REQUIRED HINTS $ENV{ZEPHYR_BASE})
project(px4_gps_test)

target_sources(app PRIVATE
	src/main.cpp
	src/nmea_receiver.c
)
target_link_libraries(app PRIVATE px4_interface)
```

## prj.conf
```kconfig
CONFIG_ZTEST=y
CONFIG_ZTEST_STACK_SIZE=4096
CONFIG_PX4=y
CONFIG_PX4_BOARD_CONFIG="zephyr_generic_gps"
CONFIG_EMUL=y
```

## app.overlay
```dts
/ {
	euart0: uart-emul {
		compatible = "zephyr,uart-emul";
		status = "okay";
		/* the NMEA sentences of one fix */
		rx-fifo-size = <512>;
	};

	px4-serial-ports {
		compatible = "px4,serial-ports";

		gps1 {
			uart = <&euart0>;
			path = "/dev/ttyS1";
		};
	};
};
```

## src/main.cpp
```c
/****************************************************************************
 *
 *   Copyright (c) 2026 PX4 Development Team. All rights reserved.
 *
 * Redistribution and use in source and binary forms, with or without
 * modification, are permitted provided that the following conditions
 * are met:
 *
 * 1. Redistributions of source code must retain the above copyright
 *    notice, this list of conditions and the following disclaimer.
 * 2. Redistributions in binary form must reproduce the above copyright
 *    notice, this list of conditions and the following disclaimer in
 *    the documentation and/or other materials provided with the
 *    distribution.
 * 3. Neither the name PX4 nor the names of its contributors may be
 *    used to endorse or promote products derived from this software
 *    without specific prior written permission.
 *
 * THIS SOFTWARE IS PROVIDED BY THE COPYRIGHT HOLDERS AND CONTRIBUTORS
 * "AS IS" AND ANY EXPRESS OR IMPLIED WARRANTIES, INCLUDING, BUT NOT
 * LIMITED TO, THE IMPLIED WARRANTIES OF MERCHANTABILITY AND FITNESS
 * FOR A PARTICULAR PURPOSE ARE DISCLAIMED. IN NO EVENT SHALL THE
 * COPYRIGHT OWNER OR CONTRIBUTORS BE LIABLE FOR ANY DIRECT, INDIRECT,
 * INCIDENTAL, SPECIAL, EXEMPLARY, OR CONSEQUENTIAL DAMAGES (INCLUDING,
 * BUT NOT LIMITED TO, PROCUREMENT OF SUBSTITUTE GOODS OR SERVICES; LOSS
 * OF USE, DATA, OR PROFITS; OR BUSINESS INTERRUPTION) HOWEVER CAUSED
 * AND ON ANY THEORY OF LIABILITY, WHETHER IN CONTRACT, STRICT
 * LIABILITY, OR TORT (INCLUDING NEGLIGENCE OR OTHERWISE) ARISING IN
 * ANY WAY OUT OF THE USE OF THIS SOFTWARE, EVEN IF ADVISED OF THE
 * POSSIBILITY OF SUCH DAMAGE.
 *
 ****************************************************************************/

#include "nmea_receiver.h"

#include <px4_zephyr.h>
#include <uORB/Subscription.hpp>
#include <uORB/topics/sensor_gnss.h>

#include <string.h>

#include <zephyr/ztest.h>

static constexpr int FIX_TIMEOUT_MS{3000};

static bool wait_for_fix(sensor_gnss_s &sensor_gnss)
{
	uORB::Subscription subscription{ORB_ID(sensor_gnss)};

	for (int i = 0; i < FIX_TIMEOUT_MS; i++) {
		if (subscription.update(&sensor_gnss) && (sensor_gnss.fix_type == sensor_gnss_s::FIX_TYPE_3D)) {
			return true;
		}

		k_sleep(K_MSEC(1));
	}

	return false;
}

static int run(const char *command)
{
	char buffer[64];
	strncpy(buffer, command, sizeof(buffer) - 1);
	buffer[sizeof(buffer) - 1] = '\0';

	char *argv[8] {};
	int argc = 0;
	char *saveptr = nullptr;

	for (char *token = strtok_r(buffer, " ", &saveptr); token != nullptr && argc < 8;
	     token = strtok_r(nullptr, " ", &saveptr)) {
		argv[argc++] = token;
	}

	return px4_zephyr_run_command(argc, argv);
}

static void *setup(void)
{
	zassert_ok(px4_zephyr_init());
	nmea_receiver_start();
	zassert_ok(run("gps start -d " NMEA_RECEIVER_TTY " -p nmea -b 115200"));

	return nullptr;
}

static void teardown(void *fixture)
{
	run("gps stop");
	nmea_receiver_stop();
}

ZTEST(px4_gps, test_fix)
{
	sensor_gnss_s sensor_gnss{};
	zassert_true(wait_for_fix(sensor_gnss));

	zassert_within(sensor_gnss.latitude, 47.2852331667, 1e-9);
	zassert_within(sensor_gnss.longitude, 8.565265, 1e-9);
	zassert_within(sensor_gnss.altitude_msl, 499.6, 1e-3);
	zassert_within(sensor_gnss.altitude_ellipsoid, 547.6, 1e-3);
	zassert_equal(sensor_gnss.satellites_used, 8);

	// the GST standard deviations of the latitude, longitude and altitude
	zassert_within(sensor_gnss.eph, 0.0305f, 1e-4f);
	zassert_within(sensor_gnss.epv, 0.031f, 1e-4f);
	zassert_within(sensor_gnss.hdop, 1.18f, 1e-4f);
	zassert_within(sensor_gnss.vdop, 1.54f, 1e-4f);

	// 10 knots to the east
	zassert_true(sensor_gnss.vel_ned_valid);
	zassert_within(sensor_gnss.vel_north, 0.f, 1e-3f);
	zassert_within(sensor_gnss.vel_east, 5.1444f, 1e-3f);
}

ZTEST(px4_gps, test_baudrate)
{
	sensor_gnss_s sensor_gnss{};
	zassert_true(wait_for_fix(sensor_gnss));

	zassert_equal(nmea_receiver_baudrate(), 115200);
}

ZTEST_SUITE(px4_gps, nullptr, setup, nullptr, nullptr, teardown);
```

## src/nmea_receiver.c
```c
/****************************************************************************
 *
 *   Copyright (c) 2026 PX4 Development Team. All rights reserved.
 *
 * Redistribution and use in source and binary forms, with or without
 * modification, are permitted provided that the following conditions
 * are met:
 *
 * 1. Redistributions of source code must retain the above copyright
 *    notice, this list of conditions and the following disclaimer.
 * 2. Redistributions in binary form must reproduce the above copyright
 *    notice, this list of conditions and the following disclaimer in
 *    the documentation and/or other materials provided with the
 *    distribution.
 * 3. Neither the name PX4 nor the names of its contributors may be
 *    used to endorse or promote products derived from this software
 *    without specific prior written permission.
 *
 * THIS SOFTWARE IS PROVIDED BY THE COPYRIGHT HOLDERS AND CONTRIBUTORS
 * "AS IS" AND ANY EXPRESS OR IMPLIED WARRANTIES, INCLUDING, BUT NOT
 * LIMITED TO, THE IMPLIED WARRANTIES OF MERCHANTABILITY AND FITNESS
 * FOR A PARTICULAR PURPOSE ARE DISCLAIMED. IN NO EVENT SHALL THE
 * COPYRIGHT OWNER OR CONTRIBUTORS BE LIABLE FOR ANY DIRECT, INDIRECT,
 * INCIDENTAL, SPECIAL, EXEMPLARY, OR CONSEQUENTIAL DAMAGES (INCLUDING,
 * BUT NOT LIMITED TO, PROCUREMENT OF SUBSTITUTE GOODS OR SERVICES; LOSS
 * OF USE, DATA, OR PROFITS; OR BUSINESS INTERRUPTION) HOWEVER CAUSED
 * AND ON ANY THEORY OF LIABILITY, WHETHER IN CONTRACT, STRICT
 * LIABILITY, OR TORT (INCLUDING NEGLIGENCE OR OTHERWISE) ARISING IN
 * ANY WAY OUT OF THE USE OF THIS SOFTWARE, EVEN IF ADVISED OF THE
 * POSSIBILITY OF SUCH DAMAGE.
 *
 ****************************************************************************/

#include "nmea_receiver.h"

#include <zephyr/device.h>
#include <zephyr/drivers/serial/uart_emul.h>
#include <zephyr/drivers/uart.h>
#include <zephyr/kernel.h>
#include <zephyr/sys/printk.h>
#include <zephyr/ztest.h>

#define FIX_INTERVAL_MS 100

static const struct device *const uart = DEVICE_DT_GET(DT_NODELABEL(euart0));

/* tenths of a second since noon, the UTC time of the fixes, which must increase */
static uint32_t fix_time;

static void send_sentence(const char *body)
{
	char sentence[96];
	uint8_t checksum = 0;

	for (size_t i = 0; body[i] != '\0'; i++) {
		checksum ^= (uint8_t)body[i];
	}

	const int len = snprintk(sentence, sizeof(sentence), "$%s*%02X\r\n", body, checksum);

	uart_emul_put_rx_data(uart, (const uint8_t *)sentence, len);
}

/* a 3D fix with 8 satellites at 47.2852331667 N, 8.565265 E and 499.6 m above MSL, moving east
 * at 10 knots
 */
static void send_fix(struct k_timer *timer)
{
	const uint32_t seconds = 12U * 3600U + fix_time / 10U;
	char time[16];
	char body[80];

	snprintk(time, sizeof(time), "%02u%02u%02u.%u0", seconds / 3600U, (seconds / 60U) % 60U,
		 seconds % 60U, fix_time % 10U);
	fix_time++;

	snprintk(body, sizeof(body), "GPGGA,%s,4717.11399,N,00833.91590,E,1,08,1.18,499.6,M,48.0,M,,",
		 time);
	send_sentence(body);
	send_sentence("GPGSA,A,3,04,05,09,12,24,25,29,31,,,,,1.94,1.18,1.54");
	snprintk(body, sizeof(body), "GPGST,%s,0.006,0.023,0.020,273.6,0.023,0.020,0.031", time);
	send_sentence(body);
	snprintk(body, sizeof(body), "GPRMC,%s,A,4717.11399,N,00833.91590,E,10.0,90.0,121026,,,A",
		 time);
	send_sentence(body);
}

K_TIMER_DEFINE(fix_timer, send_fix, NULL);

void nmea_receiver_start(void)
{
	k_timer_start(&fix_timer, K_NO_WAIT, K_MSEC(FIX_INTERVAL_MS));
}

void nmea_receiver_stop(void)
{
	k_timer_stop(&fix_timer);
}

uint32_t nmea_receiver_baudrate(void)
{
	struct uart_config config;

	zassert_ok(uart_config_get(uart, &config));
	return config.baudrate;
}
```

## src/nmea_receiver.h
```c
/****************************************************************************
 *
 *   Copyright (c) 2026 PX4 Development Team. All rights reserved.
 *
 * Redistribution and use in source and binary forms, with or without
 * modification, are permitted provided that the following conditions
 * are met:
 *
 * 1. Redistributions of source code must retain the above copyright
 *    notice, this list of conditions and the following disclaimer.
 * 2. Redistributions in binary form must reproduce the above copyright
 *    notice, this list of conditions and the following disclaimer in
 *    the documentation and/or other materials provided with the
 *    distribution.
 * 3. Neither the name PX4 nor the names of its contributors may be
 *    used to endorse or promote products derived from this software
 *    without specific prior written permission.
 *
 * THIS SOFTWARE IS PROVIDED BY THE COPYRIGHT HOLDERS AND CONTRIBUTORS
 * "AS IS" AND ANY EXPRESS OR IMPLIED WARRANTIES, INCLUDING, BUT NOT
 * LIMITED TO, THE IMPLIED WARRANTIES OF MERCHANTABILITY AND FITNESS
 * FOR A PARTICULAR PURPOSE ARE DISCLAIMED. IN NO EVENT SHALL THE
 * COPYRIGHT OWNER OR CONTRIBUTORS BE LIABLE FOR ANY DIRECT, INDIRECT,
 * INCIDENTAL, SPECIAL, EXEMPLARY, OR CONSEQUENTIAL DAMAGES (INCLUDING,
 * BUT NOT LIMITED TO, PROCUREMENT OF SUBSTITUTE GOODS OR SERVICES; LOSS
 * OF USE, DATA, OR PROFITS; OR BUSINESS INTERRUPTION) HOWEVER CAUSED
 * AND ON ANY THEORY OF LIABILITY, WHETHER IN CONTRACT, STRICT
 * LIABILITY, OR TORT (INCLUDING NEGLIGENCE OR OTHERWISE) ARISING IN
 * ANY WAY OUT OF THE USE OF THIS SOFTWARE, EVEN IF ADVISED OF THE
 * POSSIBILITY OF SUCH DAMAGE.
 *
 ****************************************************************************/

/**
 * @file nmea_receiver.h
 *
 * A GNSS receiver sending NMEA 0183 sentences on an emulated UART. Zephyr's struct device can't
 * be used from C++, where PX4 has a device namespace.
 */

#pragma once

#include <stdint.h>

#ifdef __cplusplus
extern "C" {
#endif

#define NMEA_RECEIVER_TTY "/dev/ttyS1"

/** Send the GGA, GSA, GST and RMC sentences of a fix every 100 ms. */
void nmea_receiver_start(void);

void nmea_receiver_stop(void);

/** The baudrate the UART is configured for. */
uint32_t nmea_receiver_baudrate(void);

#ifdef __cplusplus
}
#endif
```
